## buildroot-2018.02.11/package/gst-omx/01_gst-omx/Config.in
```kconfig
config BR2_PACKAGE_GST_OMX
	bool "gst-omx"
	depends on BR2_PACKAGE_GSTREAMER1
	select BR2_PACKAGE_GST1_PLUGINS_BASE
	help
	  GStreamer OpenMAX IL plugin.
	  Allows GStreamer to use OpenMAX IL decoders/encoders.

	  https://gstreamer.freedesktop.org/

if BR2_PACKAGE_GST_OMX

config BR2_PACKAGE_GST_OMX_TARGET_GENERIC
	bool "generic target"
	default y
	help
	  Use generic OpenMAX IL target (compatible with Allwinner CedarX).

endif
```

## buildroot-2018.02.11/package/libcedarx/Config.in
```kconfig
config BR2_PACKAGE_LIBCEDARX
	depends on BR2_PACKAGE_LIBCEDARC
	depends on BR2_PACKAGE_OPENSSL
	bool "libcedarx"
	help
		Allwinner CedarX is a middware to process multimedia content.

comment "libcedarx needs libcedarc"
	depends on !BR2_PACKAGE_LIBCEDARC
```

## buildroot-2018.02.11/package/rtl8723bu/Config.in
```kconfig
config BR2_PACKAGE_RTL8723BU
	bool "rtl8723bu"
	depends on BR2_LINUX_KERNEL
	depends on !BR2_STATIC_LIBS
	help
	  rtl8723bu wifi driver

	  https://github.com/lwfinger/rtl8723bu

comment "rtl8723bu needs a Linux kernel to be built and dynamic libraries"
	depends on !BR2_LINUX_KERNEL || BR2_STATIC_LIBS
```

## buildroot-2018.02.11/package/rtl8723ds/Config.in
```kconfig
config BR2_PACKAGE_RTL8723DS
	bool "rtl8723ds"
	depends on BR2_LINUX_KERNEL
	help
	  Realtek rtl8723ds SDIO wifi driver.

	  Source is provided from the local third_party tree.

comment "rtl8723ds needs a Linux kernel to be built"
	depends on !BR2_LINUX_KERNEL
```

## configs/licheepi_nano_defconfig
```kconfig
CONFIG_ARM=y
CONFIG_ARCH_SUNXI=y
CONFIG_MACH_SUNIV=y
CONFIG_DRAM_CLK=216
CONFIG_SYS_CLK_FREQ=720000000
CONFIG_DRAM_ZQ=0
CONFIG_VIDEO_SUNXI=y
CONFIG_VIDEO_LCD_MODE="x:640,y:480,depth:24,pclk_khz:25175,le:48,ri:16,up:33,lo:10,hs:96,vs:2,sync:0,vmode:0"
CONFIG_VIDEO_LCD_DCLK_PHASE=0
CONFIG_VIDEO_LCD_PANEL_PARALLEL=y
CONFIG_VIDEO=y
CONFIG_CFB_CONSOLE=y
CONFIG_VGA_AS_SINGLE_DEVICE=y
CONFIG_VIDEO_SW_CURSOR=y
# CONFIG_PYLIBFDT is not set
CONFIG_DEFAULT_DEVICE_TREE="suniv-f1c100s-licheepi-nano"
CONFIG_SPL=y
# CONFIG_SPL_DM_SERIAL is not set
```

## drivers/media/platform/sunxi/suniv-tvd/Kconfig
```kconfig
config VIDEO_SUNIV_F1C100S_TVD
	tristate "Allwinner F1C100S/F1C200S TVD capture driver"
	depends on VIDEO_DEV && VIDEO_V4L2
	depends on ARCH_SUNXI || COMPILE_TEST
	depends on OF
	select VIDEOBUF2_DMA_CONTIG
	select VIDEOBUF2_V4L2
	select DMA_SHARED_BUFFER
	help
	  V4L2 capture driver for the analog TV decoder found on
	  Allwinner F1C100S/F1C200S class SoCs.

	  The current driver exposes /dev/videoX and captures NV16 frames.

	  To compile this driver as a module, choose M here. The module will
	  be called suniv_f1c100s_tvd.
```

## drivers/net/wireless/esp8089/Kconfig
```kconfig
config ESP8089_SPI
	tristate "Espressif ESP8089 SPI WiFi support"
	depends on WLAN && MAC80211 && SPI && GPIOLIB
	depends on CFG80211
	help
	  This enables support for ESP8089 WiFi connected over SPI.
	  The driver keeps the current board-info based bring-up path and
	  expects board-specific SPI bus and IRQ numbers to be provided by
	  module parameters when loaded as a module.

	  To compile this driver as a module, choose M here. The module will
	  be called esp8089-spi.
```

## drivers/staging/shirogane/Kconfig
```kconfig
# SPDX-License-Identifier: GPL-2.0
menuconfig SHIROGANE
    tristate "Shirogane staging drivers"
    help
      This option enables Shirogane Staging Drivers.

if SHIROGANE

config SHIROGANE_SIMPLE_ST7701_INIT
	tristate "Simple ST7701 LCD initialization driver"
    depends on OF
	help
	  A really simple driver to bit-bang the initialization sequence
	  for ST7701-based LCDs over GPIOs, based on device tree settings.


endif # SHIROGANE
```
